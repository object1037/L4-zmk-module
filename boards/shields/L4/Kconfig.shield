## boards/shields/L4/Kconfig.shield
```kconfig
config SHIELD_L4_LEFT
    def_bool $(shields_list_contains,L4_left)
config SHIELD_L4_RIGHT
    def_bool $(shields_list_contains,L4_right)
```

## boards/shields/l4/Kconfig.defconfig
```kconfig
if SHIELD_L4_LEFT

config ZMK_KEYBOARD_NAME
	default "L4"

config ZMK_SPLIT_ROLE_CENTRAL
	default y

endif

if SHIELD_L4_LEFT || SHIELD_L4_RIGHT

config ZMK_SPLIT
	default y

endif
```

## boards/shields/l4/Kconfig.shield
```kconfig
config SHIELD_L4_LEFT
    def_bool $(shields_list_contains,l4_left)
config SHIELD_L4_RIGHT
    def_bool $(shields_list_contains,l4_right)
```
